`timescale 1ns / 1ps

module ha_tff_hash_v001 (
    input  wire         clk,
    input  wire         rst,
    
    input  wire [103:0] tuple_in,
    input  wire         valid_in,
    
    output reg  [11:0]  hash_0,
    output reg  [11:0]  hash_1,
    output reg  [11:0]  hash_2,
    output reg  [11:0]  hash_3,
    output reg          valid_out
);

    // Combinatorial XOR arrays for 4 independent hashes
    // In a real synthesis environment, these would be generated by a Python script 
    // to guarantee avalanching and independence. For v001, we use static XOR folding.
    
    wire [11:0] h0_comb;
    wire [11:0] h1_comb;
    wire [11:0] h2_comb;
    wire [11:0] h3_comb;
    
    // Seed 0: Linear folding
    assign h0_comb = tuple_in[11:0] ^ tuple_in[23:12] ^ tuple_in[35:24] ^ 
                     tuple_in[47:36] ^ tuple_in[59:48] ^ tuple_in[71:60] ^ 
                     tuple_in[83:72] ^ tuple_in[95:84] ^ {4'hA, tuple_in[103:96]};

    // Seed 1: Bit-reversed folding
    wire [103:0] rev_tuple;
    genvar i;
    generate
        for (i=0; i<104; i=i+1) begin : rev
            assign rev_tuple[i] = tuple_in[103-i];
        end
    endgenerate
    
    assign h1_comb = rev_tuple[11:0] ^ rev_tuple[23:12] ^ rev_tuple[35:24] ^ 
                     rev_tuple[47:36] ^ rev_tuple[59:48] ^ rev_tuple[71:60] ^ 
                     rev_tuple[83:72] ^ rev_tuple[95:84] ^ {4'h5, rev_tuple[103:96]};

    // Seed 2: Shifted by 3
    assign h2_comb = h0_comb ^ (h0_comb << 3) ^ (h0_comb >> 5) ^ 12'h3A7;
    
    // Seed 3: Shifted and mixed with h1
    assign h3_comb = h1_comb ^ (h0_comb << 7) ^ (h1_comb >> 2) ^ 12'hC2F;

    always @(posedge clk) begin
        if (rst) begin
            hash_0    <= 0;
            hash_1    <= 0;
            hash_2    <= 0;
            hash_3    <= 0;
            valid_out <= 0;
        end else begin
            valid_out <= valid_in;
            if (valid_in) begin
                hash_0 <= h0_comb;
                hash_1 <= h1_comb;
                hash_2 <= h2_comb;
                hash_3 <= h3_comb;
            end
        end
    end

endmodule
